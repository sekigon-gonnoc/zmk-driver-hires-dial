## Kconfig
```kconfig
menuconfig ZMK_HIRES_DIAL
    bool "High-resolution ZMK dial"
    default y
    depends on DT_HAS_SEKIGON_HIRES_DIAL_ENABLED
    depends on SENSOR && GPIO
    select I2C
    help
      Enable a high-resolution dial and its encoder behavior.

if ZMK_HIRES_DIAL

config ZMK_HIRES_DIAL_BEHAVIOR_INIT_PRIORITY
    int
    default 91
    help
      Initialization priority for behaviors which reference the dial sensor.
      This must be greater than SENSOR_INIT_PRIORITY (90 by default).

config ZMK_HIRES_DIAL_SCROLL
    bool "High-resolution dial scrolling"
    default n
    depends on ZMK_POINTING
    help
      Allow dial sensor bindings to emit standard vertical or horizontal
      wheel input events. This works with both regular and smooth ZMK scrolling.

config ZMK_HIRES_DIAL_RADIAL_CONTROLLER
    bool "Windows Radial Controller support"
    default n
    help
      Expose the dial as a Windows Radial Controller over USB and BLE.

config ZMK_HIRES_DIAL_RADIAL_CONTROLLER_BLE_QUEUE_SIZE
    int "Radial Controller BLE report queue size"
    default 16
    depends on ZMK_HIRES_DIAL_RADIAL_CONTROLLER && ZMK_BLE

module = ZMK_HIRES_DIAL
module-str = zmk_hires_dial
source "subsys/logging/Kconfig.template.log_config"

endif

config USB_HID_DEVICE_COUNT
    default 2 if ZMK_HIRES_DIAL_RADIAL_CONTROLLER && ZMK_USB
```

## dts/bindings/behaviors/zmk,behavior-hires-dial-encoder.yaml
```yaml
# Copyright (c) 2026 sekigon-gonnoc
# SPDX-License-Identifier: MIT

description: High-resolution dial encoder behavior

compatible: "zmk,behavior-hires-dial-encoder"

properties:
  "#sensor-binding-cells":
    type: int
    required: true
    const: 2
  bindings:
    type: phandles
    required: true
  sensor:
    type: phandle
    required: true
    description: PAT912x high-resolution dial sensor providing counts-per-revolution.
  tap-ms:
    type: int
    default: 5

sensor-binding-cells:
  # ZMK's sensor keymap parser reads these canonical cell names into
  # zmk_behavior_binding.param1 and param2.
  - param1
  - param2
```

## dts/bindings/behaviors/zmk,behavior-hires-dial-radial-controller-button.yaml
```yaml
# Copyright (c) 2026 sekigon-gonnoc
# SPDX-License-Identifier: MIT

description: Windows Radial Controller button behavior

compatible: "zmk,behavior-hires-dial-radial-controller-button"

properties:
  "#binding-cells":
    type: int
    required: true
    const: 0
```

## dts/bindings/behaviors/zmk,behavior-hires-dial-scroll.yaml
```yaml
# Copyright (c) 2026 sekigon-gonnoc
# SPDX-License-Identifier: MIT

description: Scaled high-resolution dial wheel behavior

compatible: "zmk,behavior-hires-dial-scroll"

properties:
  "#sensor-binding-cells":
    type: int
    required: true
    const: 2
  sensor:
    type: phandle
    required: true
    description: PAT912x high-resolution dial sensor providing counts-per-revolution.
  input-code:
    type: int
    required: true

sensor-binding-cells:
  # ZMK's sensor keymap parser reads these canonical cell names into
  # zmk_behavior_binding.param1 and param2.
  - param1
  - param2
```

## dts/bindings/sekigon,hires-dial-source.yaml
```yaml
# SPDX-License-Identifier: MIT

description: High-resolution dial sensor source with per-layer dynamic bindings
compatible: "sekigon,hires-dial-source"

properties:
  source-name:
    type: string
    required: true
  label:
    type: string
    required: true
  sensor:
    type: phandle
    required: true
  sensor-index:
    type: int
    required: true
  input-unit:
    type: string
    required: true
    enum: [microdegree, tick]
  target-role:
    type: string
    required: true
```

## dts/bindings/sekigon,remote-hires-dial.yaml
```yaml
description: Virtual high-resolution dial sensor used to receive split sensor events on central.

compatible: "sekigon,remote-hires-dial"

properties:
  counts-per-revolution:
    type: int
    required: true
```

## dts/bindings/sensor/sekigon,hires-dial.yaml
```yaml
# Copyright 2024 Google LLC
# SPDX-License-Identifier: Apache-2.0

description: High-resolution dial

compatible: "sekigon,hires-dial"

include: i2c-device.yaml

properties:
  motion-gpios:
    type: phandle-array
    required: true
    description: GPIO connected to the active-low motion output.

  power-gpios:
    type: phandle-array
    description: Optional sensor power control GPIO.

  res-cpi:
    type: int
    default: 1275
    description: Sensor resolution in counts per inch (CPI). Maximum value is 1275.

  counts-per-revolution:
    type: int
    required: true
    description: Accumulated PAT912x Y counts for one complete dial revolution.

  motion-read-interval-ms:
    type: int
    default: 8
    description: Delay between motion reads while the active-low MOTION signal remains asserted.

  invert:
    type: boolean

  sleep1-enable:
    type: boolean

  sleep2-enable:
    type: boolean
```
